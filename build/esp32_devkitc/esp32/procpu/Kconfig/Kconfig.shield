## build/esp32_devkitc/esp32/procpu/Kconfig/arch/Kconfig
```kconfig
# Load Zephyr Arch Kconfig descriptions.
osource "D:/zephyr/external/zephyr/arch/rx/Kconfig"
osource "D:/zephyr/external/zephyr/arch/x86/Kconfig"
osource "D:/zephyr/external/zephyr/arch/xtensa/Kconfig"
osource "D:/zephyr/external/zephyr/arch/sparc/Kconfig"
osource "D:/zephyr/external/zephyr/arch/riscv/Kconfig"
osource "D:/zephyr/external/zephyr/arch/posix/Kconfig"
osource "D:/zephyr/external/zephyr/arch/mips/Kconfig"
osource "D:/zephyr/external/zephyr/arch/arm64/Kconfig"
osource "D:/zephyr/external/zephyr/arch/arm/Kconfig"
osource "D:/zephyr/external/zephyr/arch/arc/Kconfig"
```

## build/esp32_devkitc/esp32/procpu/Kconfig/boards/Kconfig.defconfig
```kconfig
# Load Zephyr board defconfig descriptions.
osource "D:/zephyr/external/zephyr/boards/espressif/esp32_devkitc/Kconfig.defconfig"
```

## build/esp32_devkitc/esp32/procpu/Kconfig/boards/Kconfig.esp32_devkitc
```kconfig
# Load board Kconfig descriptions.
osource "D:/zephyr/external/zephyr/boards/espressif/esp32_devkitc/Kconfig.esp32_devkitc"
```

## build/esp32_devkitc/esp32/procpu/Kconfig/boards/Kconfig.sysbuild
```kconfig
# Load Sysbuild board Kconfig descriptions.
osource "D:/zephyr/external/zephyr/boards/espressif/esp32_devkitc/Kconfig.sysbuild"
```

## build/esp32_devkitc/esp32/procpu/Kconfig/soc/Kconfig
```kconfig
# Load Zephyr SoC Kconfig descriptions.
osource "D:/zephyr/external/zephyr/soc/xlnx/zynqmp/Kconfig"
osource "D:/zephyr/external/zephyr/soc/xlnx/zynq7000/Kconfig"
osource "D:/zephyr/external/zephyr/soc/xlnx/versalnet/Kconfig"
osource "D:/zephyr/external/zephyr/soc/xlnx/versal2/Kconfig"
osource "D:/zephyr/external/zephyr/soc/xen/Kconfig"
osource "D:/zephyr/external/zephyr/soc/wch/ch32v/Kconfig"
osource "D:/zephyr/external/zephyr/soc/ti/simplelink/Kconfig"
osource "D:/zephyr/external/zephyr/soc/ti/mspm0/Kconfig"
osource "D:/zephyr/external/zephyr/soc/ti/lm3s6965/Kconfig"
osource "D:/zephyr/external/zephyr/soc/ti/k3/Kconfig"
osource "D:/zephyr/external/zephyr/soc/telink/tlsr/Kconfig"
osource "D:/zephyr/external/zephyr/soc/starfive/jh71xx/Kconfig"
osource "D:/zephyr/external/zephyr/soc/st/stm32/Kconfig"
osource "D:/zephyr/external/zephyr/soc/snps/qemu_arc/Kconfig"
osource "D:/zephyr/external/zephyr/soc/snps/nsim/arc_v/Kconfig"
osource "D:/zephyr/external/zephyr/soc/snps/nsim/arc_classic/Kconfig"
osource "D:/zephyr/external/zephyr/soc/snps/hsdk4xd/Kconfig"
osource "D:/zephyr/external/zephyr/soc/snps/hsdk/Kconfig"
osource "D:/zephyr/external/zephyr/soc/snps/emsk/Kconfig"
osource "D:/zephyr/external/zephyr/soc/snps/emsdp/Kconfig"
osource "D:/zephyr/external/zephyr/soc/snps/arc_iot/Kconfig"
osource "D:/zephyr/external/zephyr/soc/silabs/Kconfig"
osource "D:/zephyr/external/zephyr/soc/sifive/sifive_freedom/Kconfig"
osource "D:/zephyr/external/zephyr/soc/sensry/Kconfig"
osource "D:/zephyr/external/zephyr/soc/rockchip/Kconfig"
osource "D:/zephyr/external/zephyr/soc/renode/riscv_virtual/Kconfig"
osource "D:/zephyr/external/zephyr/soc/renode/cortex_r8_virtual/Kconfig"
osource "D:/zephyr/external/zephyr/soc/renesas/smartbond/Kconfig"
osource "D:/zephyr/external/zephyr/soc/renesas/rz/Kconfig"
osource "D:/zephyr/external/zephyr/soc/renesas/rx/Kconfig"
osource "D:/zephyr/external/zephyr/soc/renesas/rcar/Kconfig"
osource "D:/zephyr/external/zephyr/soc/renesas/ra/Kconfig"
osource "D:/zephyr/external/zephyr/soc/realtek/ec/Kconfig"
osource "D:/zephyr/external/zephyr/soc/raspberrypi/rpi_pico/Kconfig"
osource "D:/zephyr/external/zephyr/soc/quicklogic/eos_s3/Kconfig"
osource "D:/zephyr/external/zephyr/soc/qemu/virt_riscv/Kconfig"
osource "D:/zephyr/external/zephyr/soc/qemu/malta/Kconfig"
osource "D:/zephyr/external/zephyr/soc/openisa/rv32m1/Kconfig"
osource "D:/zephyr/external/zephyr/soc/openhwgroup/cva6/Kconfig"
osource "D:/zephyr/external/zephyr/soc/oct/osd32mp15x/Kconfig"
osource "D:/zephyr/external/zephyr/soc/nxp/s32/Kconfig"
osource "D:/zephyr/external/zephyr/soc/nxp/rw/Kconfig"
osource "D:/zephyr/external/zephyr/soc/nxp/mcx/Kconfig"
osource "D:/zephyr/external/zephyr/soc/nxp/lpc/Kconfig"
osource "D:/zephyr/external/zephyr/soc/nxp/layerscape/Kconfig"
osource "D:/zephyr/external/zephyr/soc/nxp/kinetis/Kconfig"
osource "D:/zephyr/external/zephyr/soc/nxp/imxrt/Kconfig"
osource "D:/zephyr/external/zephyr/soc/nxp/imx/Kconfig"
osource "D:/zephyr/external/zephyr/soc/nuvoton/numicro/Kconfig"
osource "D:/zephyr/external/zephyr/soc/nuvoton/numaker/Kconfig"
osource "D:/zephyr/external/zephyr/soc/nuvoton/npcx/Kconfig"
osource "D:/zephyr/external/zephyr/soc/nuvoton/npcm/Kconfig"
osource "D:/zephyr/external/zephyr/soc/nordic/Kconfig"
osource "D:/zephyr/external/zephyr/soc/neorv32/Kconfig"
osource "D:/zephyr/external/zephyr/soc/native/inf_clock/Kconfig"
osource "D:/zephyr/external/zephyr/soc/microchip/sam/Kconfig"
osource "D:/zephyr/external/zephyr/soc/microchip/miv/Kconfig"
osource "D:/zephyr/external/zephyr/soc/microchip/mec/Kconfig"
osource "D:/zephyr/external/zephyr/soc/mediatek/mt8xxx/Kconfig"
osource "D:/zephyr/external/zephyr/soc/lowrisc/opentitan/Kconfig"
osource "D:/zephyr/external/zephyr/soc/litex/litex_vexriscv/Kconfig"
osource "D:/zephyr/external/zephyr/soc/ite/ec/Kconfig"
osource "D:/zephyr/external/zephyr/soc/intel/raptor_lake/Kconfig"
osource "D:/zephyr/external/zephyr/soc/intel/lakemont/Kconfig"
osource "D:/zephyr/external/zephyr/soc/intel/intel_socfpga_std/Kconfig"
osource "D:/zephyr/external/zephyr/soc/intel/intel_socfpga/Kconfig"
osource "D:/zephyr/external/zephyr/soc/intel/intel_niosv/Kconfig"
osource "D:/zephyr/external/zephyr/soc/intel/intel_ish/Kconfig"
osource "D:/zephyr/external/zephyr/soc/intel/intel_adsp/Kconfig"
osource "D:/zephyr/external/zephyr/soc/intel/elkhart_lake/Kconfig"
osource "D:/zephyr/external/zephyr/soc/intel/atom/Kconfig"
osource "D:/zephyr/external/zephyr/soc/intel/apollo_lake/Kconfig"
osource "D:/zephyr/external/zephyr/soc/intel/alder_lake/Kconfig"
osource "D:/zephyr/external/zephyr/soc/infineon/cat3/Kconfig"
osource "D:/zephyr/external/zephyr/soc/infineon/cat1c/Kconfig"
osource "D:/zephyr/external/zephyr/soc/infineon/cat1b/Kconfig"
osource "D:/zephyr/external/zephyr/soc/infineon/cat1a/Kconfig"
osource "D:/zephyr/external/zephyr/soc/gd/gd32/Kconfig"
osource "D:/zephyr/external/zephyr/soc/gaisler/leon3/Kconfig"
osource "D:/zephyr/external/zephyr/soc/gaisler/gr716a/Kconfig"
osource "D:/zephyr/external/zephyr/soc/espressif/Kconfig"
osource "D:/zephyr/external/zephyr/soc/ene/kb1200/Kconfig"
osource "D:/zephyr/external/zephyr/soc/ene/kb106x/Kconfig"
osource "D:/zephyr/external/zephyr/soc/efinix/sapphire/Kconfig"
osource "D:/zephyr/external/zephyr/soc/cdns/xtensa_sample_controller/Kconfig"
osource "D:/zephyr/external/zephyr/soc/cdns/sample_controller32/Kconfig"
osource "D:/zephyr/external/zephyr/soc/cdns/dc233c/Kconfig"
osource "D:/zephyr/external/zephyr/soc/brcm/bcmvk/Kconfig"
osource "D:/zephyr/external/zephyr/soc/brcm/bcm2712/Kconfig"
osource "D:/zephyr/external/zephyr/soc/brcm/bcm2711/Kconfig"
osource "D:/zephyr/external/zephyr/soc/bflb/Kconfig"
osource "D:/zephyr/external/zephyr/soc/atmel/sam0/Kconfig"
osource "D:/zephyr/external/zephyr/soc/atmel/sam/Kconfig"
osource "D:/zephyr/external/zephyr/soc/aspeed/Kconfig"
osource "D:/zephyr/external/zephyr/soc/arm/Kconfig"
osource "D:/zephyr/external/zephyr/soc/arm/beetle/Kconfig"
osource "D:/zephyr/external/zephyr/soc/antmicro/myra/Kconfig"
osource "D:/zephyr/external/zephyr/soc/andestech/Kconfig"
osource "D:/zephyr/external/zephyr/soc/amd/acp_6_0/Kconfig"
osource "D:/zephyr/external/zephyr/soc/ambiq/Kconfig"
osource "D:/zephyr/external/zephyr/soc/aesc/Kconfig"
osource "D:/zephyr/external/zephyr/soc/adi/max32/Kconfig"
```
